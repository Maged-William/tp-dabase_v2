## config/west.yml
```yaml
manifest:
  remotes:
    - name: zmkfirmware
      url-base: https://github.com/zmkfirmware
    - name: maged
      url-base: https://github.com/Maged-William
  projects:
    - name: zmk
      remote: zmkfirmware
      revision: main
      import: app/west.yml
    - name: tp-promini-driver
      remote: maged
      revision: spi-prototype
  self:
    path: config
```
